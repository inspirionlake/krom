/*
 * protocol.cpp
 *
 * Created: 21.06.2018 18:45:41
 *  Author: Dmitry
 */ 

//protocol
#include <avr/io.h>
#include <avr/interrupt.h>

#include "uart.h"
#include "protocol.h"
	
/*
  Name  : CRC-8
  Poly  : 0x31    x^8 + x^5 + x^4 + 1
  Init  : 0xFF
  Revert: false
  XorOut: 0x00
  Check : 0xF7 ("123456789")
  MaxLen: 15 байт (127 бит) - обнаружение
    одинарных, двойных, тройных и всех нечетных ошибок
*/

const unsigned char Crc8Table[256] = {
    0x00, 0x31, 0x62, 0x53, 0xC4, 0xF5, 0xA6, 0x97,
    0xB9, 0x88, 0xDB, 0xEA, 0x7D, 0x4C, 0x1F, 0x2E,
    0x43, 0x72, 0x21, 0x10, 0x87, 0xB6, 0xE5, 0xD4,
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    0x3B, 0x0A, 0x59, 0x68, 0xFF, 0xCE, 0x9D, 0xAC
};

uint8_t Crc8(uint8_t *pcBlock, uint8_t len)
{
    uint8_t crc = 0xFF;

    while (len--)
        crc = Crc8Table[crc ^ *pcBlock++];

    return crc;
}

uint8_t checkCRC(uint8_t rec_crc, uint8_t frameLength, uint8_t *frame) {
	uint8_t calc_crc = Crc8(frame, frameLength);
	if (calc_crc == rec_crc) {
		return 0;
	}
	else {
		return 1;
	}
}

void makeFrame(uint8_t *frame, uint8_t *number_of_bytes, uint8_t function_code, uint8_t *data, uint8_t number_of_data_bytes) {
	*number_of_bytes = 5 + number_of_data_bytes;	//	start_code(1) + function_code(1) + number_of_data_bytes + CRC(1) + end_code(1) + data = 5 + data
	uint8_t index = 0;
	frame[index] = start_code;
	
	++index;
	frame[index] = function_code;
	
	++index;
	frame[index] = number_of_data_bytes;
	
	uint8_t i = 0;
	for (i = 0; i < number_of_data_bytes; i++) {
		++index;
		frame[index] = data[i];
	}
	
	++index;
	frame[index] = end_code;
	
	uint8_t crc = Crc8(frame, *number_of_bytes - 1);
	frame[index] = crc;
	
	++index;
	frame[index] = end_code;
}

uint8_t frame_buffer_state = 0;

uint8_t sendFrame(uint8_t *frame, uint8_t number_of_bytes) {
	uint8_t i = 0;
	if (frame_buffer_state == 0) {
		frame_buffer_state = 1;
		for (i = 0; i < number_of_bytes; i++) {
			if (putInTrmBuf(frame[i])) {
				return 1;	//	frame was loaded in buffer not completely
			}
		}
		uartStartTrmInInterrupt();
		return 0;	//	frame was loaded in buffer completely
	}
	return 2;	//	frame buffer is busy. try load later
}
uint8_t receiveFrame(uint8_t *buffer, uint8_t *frame) {
	uint8_t i = 0;
	for (i = 0; i < MAX_BUFFER_SIZE; i++) {
		if (buffer[i] == start_code) {
			break;
		}
	}
	uint8_t j = i + 2;	//	set index on byte with value which describe number of data bytes
	uint8_t frame_length = 5 + buffer[j];
	
	for (j = 0; j < frame_length; j++) {	//	writing all frame in *frame
		frame[j] = buffer[i];
		++i;
	}
	return 0;		//	all ok
}

uint8_t decodeFrame(uint8_t *frame, uint8_t *function_code, uint8_t *data) {
	uint8_t index = 0;
	if (frame[index] != start_code) {
		return 1;	//	frame is not correct
	}
	
	++index;	//	set index on function code
	*function_code = frame[index];
	
	++index;	//	set index on number of data bytes
	uint8_t j = 0;
	uint8_t number_of_data_bytes = frame[index];
	
	++index;	//	set index on first data byte
	for (j = 0; j < number_of_data_bytes; j++) {
		data[j] = frame[index];
		++index;
	}
	
	//	now index on crc byte
	uint8_t crc = frame[index];
	
	frame[index] = end_code;	//	I'm calculate crc without crc byte, only: start code, function code, number of data bytes, data, end code
	
	if (checkCRC(crc, 4 + number_of_data_bytes, frame) == 1) {
		return 1;	//	crc error
	}
	
	++index;
	if (frame[index] == end_code) {
		return 0;	//	frame is correct
	}
	else {
		return 1;	//	end_code of frame not found
	}
}


//protocol